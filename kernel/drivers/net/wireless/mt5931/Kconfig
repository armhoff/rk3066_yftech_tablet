## kernel/drivers/net/wireless/mt5931/Kconfig
```kconfig
	config MT5931
	  depends on WLAN_80211 && MMC
	  select WIRELESS_EXT
	  select WEXT_PRIV
	  select IEEE80211
	  select FW_LOADER
	  select CFG80211
	  select NL80211_TESTMODE
	  tristate "MediaTek MT5931 SDIO WiFi"
	  ---help---
	    A driver for MTK MT5931 SDIO WLAN devices.
	    So far, the following modules have been verified: MTK5931
```
